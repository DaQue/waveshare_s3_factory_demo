## sdkconfig.defaults
```kconfig
# Increase main task stack for Rust std runtime
CONFIG_ESP_MAIN_TASK_STACK_SIZE=32768
# Keep XPowers on legacy I2C API to avoid mixed old/new driver conflict.
CONFIG_XPOWERS_ESP_IDF_OLD_API=y
# CONFIG_XPOWERS_ESP_IDF_NEW_API is not set

# WiFi
CONFIG_ESP_WIFI_ENABLED=y

# HTTPS / TLS (for OpenWeatherMap API)
CONFIG_ESP_TLS_USING_MBEDTLS=y
CONFIG_MBEDTLS_SSL_MAX_CONTENT_LEN=16384
CONFIG_ESP_HTTP_CLIENT_ENABLE_HTTPS=y

# NTP
CONFIG_LWIP_SNTP_MAX_SERVERS=2

# Pthread stack defaults (for spawned threads)
CONFIG_PTHREAD_TASK_STACK_SIZE_DEFAULT=8192
```
